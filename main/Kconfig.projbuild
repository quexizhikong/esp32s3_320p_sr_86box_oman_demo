## main/Kconfig.projbuild
```kconfig
menu "Board Configuration"

choice T3E_LANAGUAGE
    prompt "Language Select"
    default LANAGUAGE_CHS
    help
        Select Language T3E.              
    config LANAGUAGE_CHS
        bool "CHS"  
    config LANAGUAGE_CHT
        bool "CHT"                                        
endchoice   

choice T3W_GANG
    prompt "T3W Gang Select"
    default CUSTOM_T3W_4_GANG
    help
        Select custom T3E.              
    config CUSTOM_T3W_1_GANG
        bool "T3W 1 Gang"  
    config CUSTOM_T3W_2_GANG
        bool "T3W 2 Gang" 
    config CUSTOM_T3W_3_GANG
        bool "T3W 3 Gang" 
     config CUSTOM_T3W_4_GANG
        bool "T3W 4 Gang"                                                        
endchoice 

    choice EXAMPLE_BOARD_SELECT
        prompt "board select"
        default EXAMPLE_BOARD_1
        help
            Select hardward board 

        config EXAMPLE_BOARD_1
            bool "hardward 1"
            
        config EXAMPLE_BOARD_2
            bool "hardward 2"   
            
         config EXAMPLE_BOARD_3
            bool "hardward 3"              
    endchoice
    
    choice
        prompt "Select a touch panel controller model."
        default LV_TOUCH_CONTROLLER_GSL1680
        help
            Select the controller for your touch panel.

        config LV_TOUCH_CONTROLLER_GSL1680
            bool "GSL1680"
        config LV_TOUCH_CONTROLLER_GSL2038
            bool "GSL2038"            
    endchoice
     
    choice EXAMPLE_LCD_CONTROLLER_MODEL
        prompt "LCD controller model"
        default EXAMPLE_LCD_I80_CONTROLLER
        help
            Select LCD controller model

        config EXAMPLE_LCD_I80_CONTROLLER
            bool "I80"
            
        config EXAMPLE_LCD_IIS_CONTROLLER
            bool "IIS"
    endchoice
    
    choice EXAMPLE_LCD_I80_CONTROLLER_MODEL
        prompt "i80 model"
        depends on EXAMPLE_LCD_I80_CONTROLLER
        default EXAMPLE_LCD_I80_CONTROLLER_ST7796
        help
            Select LCD controller model

        config EXAMPLE_LCD_I80_CONTROLLER_ST7789
            bool "ST7789"
            
        config EXAMPLE_LCD_I80_CONTROLLER_ST7796
            bool "ST7796"

        config EXAMPLE_LCD_I80_CONTROLLER_ILI9341
            bool "ILI9341"
    endchoice
 
    config EXAMPLE_LCD_I80_COLOR_IN_PSRAM
        bool "Allocate color data from PSRAM"
        depends on IDF_TARGET_ESP32S3 && EXAMPLE_LCD_I80_CONTROLLER
        default y
        help
            Enable this option if you wish to allocate the color buffer used by LVGL from PSRAM.
            Unmatched PSRAM band width with LCD requirement can lead to blurred image display.

    config EXAMPLE_LCD_I80_BUS_WIDTH
        int
        default 16 if EXAMPLE_LCD_NT35510_DATA_WIDTH_16
        default 8       
endmenu

menu "RMT Configuration"
    choice EXAMPLE_IR_PROTOCOL
        prompt "Infrared Protocol"
        default EXAMPLE_IR_PROTOCOL_NEC
        help
            Choose the IR protocol used in the example.

        config EXAMPLE_IR_PROTOCOL_NEC
            bool "NEC"
            help
                NEC is a kind of Pulse Distance Protocol.
                It uses ASK modulation and pulse distance encoding with a carrier frequency of 38 kHz.

        config EXAMPLE_IR_PROTOCOL_RC5
            bool "RC5"
            help
                The RC5 protocol was introduced by Philips.
                It uses ASK modulation and Manchester encoding with carrier frequency fixed at 36 kHz.

    endchoice

    config EXAMPLE_RMT_TX_GPIO
        int "RMT TX GPIO"
        default 18
        help
            Set the GPIO number used for transmitting the RMT signal.

    config EXAMPLE_RMT_RX_GPIO
        int "RMT RX GPIO"
        default 19
        help
            Set the GPIO number used for receiving the RMT signal.

    config EXAMPLE_RMT_TX_CHANNEL
        int "RMT TX Channel Number"
        default 0
        help
            Set the RMT TX channel number.

    config EXAMPLE_RMT_RX_CHANNEL
        int "RMT RX Channel Number"
        default 4 if IDF_TARGET_ESP32S3
        default 2
        help
            Set the RMT RX channel number.
endmenu
```
